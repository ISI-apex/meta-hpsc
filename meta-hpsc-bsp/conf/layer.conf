## meta-hpsc-bsp/conf/layer.conf
```bitbake
# We have a conf and classes directory, add to BBPATH
BBPATH .= ":${LAYERDIR}"

# We have a packages directory, add to BBFILES
BBFILES += "${LAYERDIR}/recipes-*/*/*.bb"
BBFILES += "${LAYERDIR}/recipes-*/*/*.bbappend"

BBFILE_COLLECTIONS += "hpsc"
BBFILE_PATTERN_hpsc = "^${LAYERDIR}/"
BBFILE_PRIORITY_hpsc = "5"

LAYERDEPENDS_hpsc = "core"

LAYERSERIES_COMPAT_hpsc = "thud"
```

## meta-hpsc-bsp/conf/machine/hpsc-chiplet.conf
```bitbake
#@TYPE: Machine
#@NAME: hpsc-chiplet
#@DESCRIPTION: Machine support for HPSC Chiplet.

require conf/machine/include/arm/arch-armv8.inc
require conf/machine/include/soc-family.inc

# Linux Configuration
KERNEL_IMAGETYPE ?= "Image.gz"
KERNEL_DEVICETREE ?= "hpsc/hpsc.dtb"

MACHINE_FEATURES = "vfat"

# File System Configuration
IMAGE_FSTYPES ?= "cpio.gz.u-boot"

# U-Boot Configuration
UBOOT_BINARY ?= "u-boot.bin"
UBOOT_ELF ?= "u-boot"
UBOOT_ELF_aarch64 ?= "u-boot.elf"
UBOOT_MACHINE ?= "hpsc_hpps_config"

EXTRA_IMAGEDEPENDS += "virtual/bootloader"
IMAGE_BOOT_FILES ?= "${UBOOT_BINARY}"

SERIAL_CONSOLES = "115200;ttyS0"
SERIAL_CONSOLES_CHECK = "${SERIAL_CONSOLES}"

PREFERRED_PROVIDER_virtual/kernel ?= "linux-hpsc"
PREFERRED_PROVIDER_virtual/bootloader ?= "u-boot-hpps"

EXTRA_IMAGEDEPENDS += " \
		arm-trusted-firmware \
		"

DISTRO_FEATURES_append = " systemd"
VIRTUAL-RUNTIME_init_manager = "systemd"
DISTRO_FEATURES_BACKFILL_CONSIDERED = "sysvinit"
VIRTUAL-RUNTIME_initscripts = ""
```

## meta-xilinx-bsp/conf/machine/hpsc-chiplet.conf
```bitbake
#@TYPE: Machine
#@NAME: hpsc-chiplet
#@DESCRIPTION: Machine support for HPSC Chiplet.

require conf/machine/include/tune-zynqmp.inc

MACHINE_FEATURES = "rtc ext2 ext3 vfat usbhost"

# File System Configuration
IMAGE_FSTYPES ?= "tar.gz cpio cpio.gz.u-boot"

# U-Boot Configuration
UBOOT_BINARY ?= "u-boot.bin"
UBOOT_ELF ?= "u-boot"
UBOOT_ELF_aarch64 ?= "u-boot.elf"
UBOOT_MACHINE = "hpsc_multi_defconfig"

EXTRA_IMAGEDEPENDS += "virtual/bootloader"
IMAGE_BOOT_FILES ?= "${UBOOT_BINARY}"

SERIAL_CONSOLE = "115200 ttyPS0"
SERIAL_CONSOLES_CHECK = "${SERIAL_CONSOLES}"

KERNEL_DEVICETREE = "hpsc/hpsc.dtb"

PREFERRED_PROVIDER_virtual/kernel ?= "linux-hpsc"
PREFERRED_PROVIDER_virtual/bootloader ?= "u-boot-hpps"

EXTRA_IMAGEDEPENDS += " \
		arm-trusted-firmware \
		"

DISTRO_FEATURES_append = " systemd"
VIRTUAL-RUNTIME_init_manager = "systemd"
DISTRO_FEATURES_BACKFILL_CONSIDERED = "sysvinit"
VIRTUAL-RUNTIME_initscripts = ""
```
